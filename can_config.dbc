VERSION ""

NS_ :

BS_:
BU_: Calib Configuration PedalMapping
BO_ 2147483680 Calib: 8 Calib
   SG_ SensorSelect : 0|1@0+ (1,0) [0|11] "" Vector__XXX

CM_ BO_ 2147483680 "Starts calibration";
BA_DEF_ BO_ "GenMsgBackgroundColor" STRING ;
BA_DEF_ BO_ "GenMsgForegroundColor" STRING ;
BA_DEF_ BO_ "filterlabeling" INT 0 0;
BA_DEF_DEF_ "GenMsgBackgroundColor" "#ffffff";
BA_DEF_DEF_ "GenMsgForegroundColor" "#000000";
BA_DEF_DEF_ "filterlabeling" 1;
VAL_ 2147483680 SensorSelect 0 "No Description";
